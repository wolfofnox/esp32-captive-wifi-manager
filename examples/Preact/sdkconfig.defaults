## examples/Preact/sdkconfig.defaults
```kconfig
# Enable WebSocket support
CONFIG_HTTPD_WS_SUPPORT=y

# Partition Table - Single factory app, no OTA, maximum size
CONFIG_PARTITION_TABLE_TYPE_SINGLE_APP=y
CONFIG_PARTITION_TABLE_SINGLE_APP_LARGE=y

# Disable WiFi NVS
# CONFIG_ESP_WIFI_NVS_ENABLED is not set

# Stack sizes
CONFIG_ESP_MAIN_TASK_STACK_SIZE=7168
CONFIG_ESP_TIMER_TASK_STACK_SIZE=4096
CONFIG_FREERTOS_TIMER_TASK_STACK_DEPTH=4096
CONFIG_PTHREAD_STACK_MIN=2048

# HTTP Server config
CONFIG_HTTPD_STACK_SIZE=8192

CONFIG_COMPILER_OPTIMIZATION_DEFAULT=y
CONFIG_COMPILER_OPTIMIZATION_ASSERTIONS_ENABLE=y

CONFIG_ESPTOOLPY_HEADER_FLASHSIZE_UPDATE=y

# Enable long names in FATfs for easier sd file reading
# CONFIG_FATFS_LFN_NONE is not set
CONFIG_FATFS_LFN_HEAP=y
# CONFIG_FATFS_LFN_STACK is not set

#
# Log Level
#
# CONFIG_LOG_DEFAULT_LEVEL_NONE is not set
# CONFIG_LOG_DEFAULT_LEVEL_ERROR is not set
# CONFIG_LOG_DEFAULT_LEVEL_WARN is not set
CONFIG_LOG_DEFAULT_LEVEL_INFO=y
# CONFIG_LOG_DEFAULT_LEVEL_DEBUG is not set
# CONFIG_LOG_DEFAULT_LEVEL_VERBOSE is not set
CONFIG_LOG_DEFAULT_LEVEL=3
# CONFIG_LOG_MAXIMUM_EQUALS_DEFAULT is not set
CONFIG_LOG_MAXIMUM_LEVEL_DEBUG=y
# CONFIG_LOG_MAXIMUM_LEVEL_VERBOSE is not set
CONFIG_LOG_MAXIMUM_LEVEL=4
```
